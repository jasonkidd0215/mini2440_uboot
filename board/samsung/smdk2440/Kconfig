## board/samsung/smdk2440/Kconfig
```kconfig
if TARGET_SMDK2440

config SYS_BOARD
	default "smdk2440"

config SYS_VENDOR
	default "samsung"

config SYS_SOC
	default "s3c24x0"

config SYS_CONFIG_NAME
	default "smdk2440"

config DRIVER_DM9000
	bool
	default y

config DM9000_BASE
	hex
	default 0x20000000

endif
```

## drivers/mtd/nand/Kconfig
```kconfig
config MTD_NAND_CORE
	tristate

config MTD_NAND_S3C2410_NAND
	bool "MTD NAND S3C2410"
	default n
	help
	  This is to set CONFIG_MTD_NAND_S3C2410_NAND macro

source "drivers/mtd/nand/raw/Kconfig"

source "drivers/mtd/nand/spi/Kconfig"
```
